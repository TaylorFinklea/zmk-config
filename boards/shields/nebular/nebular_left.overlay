// This file was generated from a template. Edit it to match your keyboard.
// See https://zmk.dev/docs/development/hardware-integration/new-shield for more
// instructions.

#include "nebular.dtsi"

&encoder_1 {
    status = "okay"; // Enable the encoder defined in nebular.dtsi
};

&kscan {
    // Define the GPIO pins used for columns on the left side.
    col-gpios
        = <&pro_micro 14 GPIO_ACTIVE_HIGH> // Original Col 0
        , <&pro_micro 15 GPIO_ACTIVE_HIGH> // Original Col 1
        , <&pro_micro 18 GPIO_ACTIVE_HIGH> // Original Col 2
        , <&pro_micro 19 GPIO_ACTIVE_HIGH> // Original Col 3
        , <&pro_micro 20 GPIO_ACTIVE_HIGH> // Original Col 4
        , <&pro_micro 4 GPIO_ACTIVE_HIGH>  // Encoder Button Col 5
        ;
};
