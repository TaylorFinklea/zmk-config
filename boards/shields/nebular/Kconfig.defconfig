## boards/shields/nebular/Kconfig.defconfig
```kconfig
if SHIELD_NEBULAR_LEFT

config ZMK_KEYBOARD_NAME
    default "nebular"

config ZMK_SPLIT_ROLE_CENTRAL
    default y

endif # SHIELD_NEBULAR_LEFT

if SHIELD_NEBULAR_LEFT || SHIELD_NEBULAR_RIGHT

config ZMK_SPLIT
    default y

endif # SHIELD_NEBULAR_LEFT || SHIELD_NEBULAR_RIGHT
```

## boards/shields/nebular/Kconfig.shield
```kconfig
config SHIELD_NEBULAR_LEFT
    def_bool $(shields_list_contains,nebular_left)

config SHIELD_NEBULAR_RIGHT
    def_bool $(shields_list_contains,nebular_right)
```
